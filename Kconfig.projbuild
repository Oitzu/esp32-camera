## Kconfig.projbuild
```kconfig
menu "Camera Configuration"

config OV2640_SUPPORT
	bool "OV2640 Support"
	default y
	help
		Enable this option if you want to use the OV2640.
		Disable this option off to safe memory.

config OV7725_SUPPORT
	bool "OV7725 Support"
	default y
	help
		Enable this option if you want to use the OV7725.
		Disable this option off to safe memory.

config OV9650_SUPPORT
	bool "OV9650 Support"
	default y
	help
		Enable this option if you want to use the OV9650.
		Disable this option off to safe memory.


endmenu
```
